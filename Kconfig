## Kconfig
```kconfig
# Copyright (c) 2026 tpak
# SPDX-License-Identifier: MIT

config TPAK_OS_PROFILE
    bool
    default y
    depends on DT_HAS_TPAK_BEHAVIOR_OS_SET_ENABLED || DT_HAS_TPAK_BEHAVIOR_OS_ACTION_ENABLED
    help
      Enable the volatile host OS profile and OS-aware actions.
```

## config/boards/shields/tpaktop_corne/Kconfig.shield
```kconfig
# Copyright (c) 2026 tpak
# SPDX-License-Identifier: MIT

config SHIELD_TPAKTOP_CORNE_DONGLE
    def_bool $(shields_list_contains,tpaktop_corne_dongle)
```

## config/west.yml
```yaml
manifest:
  remotes:
    - name: zmkfirmware
      url-base: https://github.com/zmkfirmware
    - name: prospector
      url-base: https://github.com/tpaktop77
  projects:
    - name: zmk
      remote: zmkfirmware
      revision: v0.3
      import: app/west.yml
    # Fork of t-ogura/prospector-zmk-module v2.2.3 with the scanner-name fix
    # (branch 20261018__fix_scanner_name_tpak).
    - name: prospector-zmk-module
      remote: prospector
      revision: af1c531849ddb9ec253944dee91f799a6c932aa7
      path: modules/prospector-zmk-module
  self:
    path: config
```

## dts/bindings/behaviors/tpak,behavior-os-action.yaml
```yaml
description: Sends an OS-aware HID action

compatible: "tpak,behavior-os-action"

include: one_param.yaml

properties:
  bindings:
    type: phandle-array
    required: true
```

## dts/bindings/behaviors/tpak,behavior-os-set.yaml
```yaml
description: Selects the volatile host OS profile

compatible: "tpak,behavior-os-set"

include: one_param.yaml
```
